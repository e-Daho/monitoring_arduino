//ATOMIX Monitoring Carte 1

//--------------  assignation des pins  ------------------

const int cpt_debat_avg = 0;
const int cpt_debat_avd = 1;
const int cpt_vit_avg = 2;
const int cpt_vit_avd = 3;
const int cpt_press_av = 2;
const int cpt_cre = 3;


//-------------------  paramètres  ----------------
const long diametre = 440;
const long nbr_trous = 24;
const long limite_rafraich = 12;
const long refresh_can = 500;

//--------------------  variables stockage  -------------------
float vitesse_avg ;
float vitesse_avd ;

int cpt_vitesse_g ;
int cpt_vitesse_d ;
long temps_g;
long temps_gdif;
long temps_d;
long temps_ddif;
long temps_can_send;
long temps_can_receive;

int debat_avg ;
int debat_avd ;
int debat_cre ;

int press_av;

int regime;
int rapport;
int vitesse;
int decal;
int temperature;

long temps;

//initialisation Canbus
#include <SPI.h>
#include "mcp_can.h"
MCP_CAN CAN(53); 
int id;


//initialisation LCD
#include <U8glib.h>
U8GLIB_ST7920_128X64 u8g(13, 11, 10, U8G_PIN_NONE);

unsigned char Flag_Recv = 0;
unsigned char len = 1;
unsigned char buf[8];
char str[20];

#define atomix_width 128
#define atomix_height 64
static unsigned char atomix_bits[] U8G_PROGMEM = {
   
   0x00, 0x00, 0x00, 0x00, 0x00, 0x00, 0x00, 0x00, 0x00, 0x00, 0x00, 0x00,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 0x03,
   0x00, 0x00, 0x00, 0x00, 0x00, 0x00, 0x00, 0xe0, 0xff, 0xe7, 0xc7, 0xe7,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 0x00,
   0x00, 0x00, 0x00, 0x80, 0xff, 0x00, 0x00, 0xe0, 0xff, 0xe7, 0x07, 0xc0,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 0x00,
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   0x00, 0x00, 0x00, 0x00, 0x00, 0x00, 0x00, 0x00, 0x00, 0x00, 0x00, 0x00,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 0x20, 0x57 };
   

void setup() {
  Serial.begin(115200);
  
   //initialisation canbus

START_INIT:  
  
if(CAN_OK == CAN.begin(CAN_1000KBPS))  
  {
    Serial.println("CAN BUS Shield init ok!");
  }
  else
  {
    Serial.println("CAN BUS Shield init fail");
    Serial.println("Init CAN BUS Shield again");
    delay(100);
    goto START_INIT;
  }

  
  pinMode(cpt_vit_avg,INPUT);
  pinMode(cpt_vit_avd,INPUT);
  digitalWrite(cpt_vit_avg,HIGH);
  digitalWrite(cpt_vit_avd,HIGH);
  attachInterrupt(0,inter_vitesse_gauche,FALLING);
  attachInterrupt(1,inter_vitesse_droite,FALLING);

  temps_g=millis();
  temps_d=millis();
  
 
//initialisation LCD
u8g.setHardwareBackup(u8g_backup_avr_spi);

  // assign default color value
//  if ( u8g.getMode() == U8G_MODE_R3G3B2 ) 
//    u8g.setColorIndex(255);     // white
//  else if ( u8g.getMode() == U8G_MODE_GRAY2BIT )
//    u8g.setColorIndex(3);         // max intensity
//  else if ( u8g.getMode() == U8G_MODE_BW )
//    u8g.setColorIndex(1);         // pixel on

if ( u8g.getMode() == U8G_MODE_GRAY2BIT )
   u8g.setColorIndex(3);         // max intensity
 else if ( u8g.getMode() == U8G_MODE_BW )
    u8g.setColorIndex(1);         // pixel on

}


//-----------------  Interruptions  -----------------------

void inter_vitesse_gauche() {
    cpt_vitesse_g++ ;
    Serial.println(cpt_vitesse_g);
}

void inter_vitesse_droite() {
 cpt_vitesse_d++ ;
  Serial.println(cpt_vitesse_d);
}

//------------------- Fonction affichage --------------

void affichage(void) {  
  u8g.setFont(u8g_font_unifont);
    
    if(regime<=9) decal=0;
    else if(regime<=99) decal=1;
    else if(regime<=999) decal=2;
    else if(regime<=9999) decal=3;
    else if(regime<=99999) decal=4;
    
    u8g.setPrintPos(86-decal*8, 36);
    u8g.print(regime);
    
    u8g.setPrintPos(97, 36);
    u8g.print("rpm");
    
    if(vitesse<=9) decal=0;
    else if(vitesse<=99) decal=1;
    else if(vitesse<=999) decal=2;
    u8g.setPrintPos(81-decal*8, 59);
    u8g.print(vitesse);
    
    u8g.setPrintPos(92, 59);
    u8g.print("Km/h");
    
    u8g.setPrintPos(0,64);
    u8g.print(temperature);
    
    u8g.setFont(u8g_font_osb21);
    u8g.setPrintPos(16,50);
    if(rapport==0) u8g.print("C");
    else if(rapport==1) u8g.print("H");
    else if(rapport==2) u8g.print("N");
    else u8g.print(rapport-2);
    
            
    u8g.drawHLine(0, 21, 128);
    u8g.drawVLine(50, 22, 42);
    u8g.drawHLine(51, 42, 76);
    u8g.drawHLine(88,0,20);
    u8g.drawHLine(88,20,20);
    
        
    if(regime>=5000){
    u8g.drawBox(0,1,28,19);
    u8g.drawBox(28,1,(regime-5000)/100,19);
    }
        
}

void accueil(void){
  u8g.drawXBMP( 0, 0, atomix_width, atomix_height, atomix_bits);
}


//-------------------  Loop ---------------------

void loop() {
  
  debat_avg=analogRead(cpt_debat_avg);
  debat_avd=analogRead(cpt_debat_avd);
  press_av=analogRead(cpt_press_av);
  debat_cre=analogRead(cpt_cre);
  
  if(cpt_vitesse_g >= limite_rafraich){
    temps_gdif = millis()-temps_g;
    temps_g = millis();  
    vitesse_avg = 3.14*diametre*3.6/((nbr_trous/limite_rafraich)*temps_gdif);
    cpt_vitesse_g=0;
    }
    
      
  if(cpt_vitesse_d >= limite_rafraich){
    temps_ddif = millis()-temps_d;
    temps_d = millis();   
    vitesse_avd = 3.14*diametre*3.6/((nbr_trous/limite_rafraich)*temps_ddif);
    cpt_vitesse_d=0;
    }

 if(millis()>=temps_d+1000){
   vitesse_avd = 0;
 }
 
 if(millis()>=temps_g+1000){
   vitesse_avg = 0;
 }
 
  
//recevoir CANBUS
for(int i=1; i<3; i++){
if(CAN_MSGAVAIL == CAN.checkReceive())           
  {
    CAN.readMsgBuf(&len, buf);   
    id = CAN.getCanId(); 
    Serial.println(id);
        
    if(id==20)
    {
      rapport = buf[0];
    }
    if(id==8192)
    {
      regime = buf[0]*10;
      temperature = buf[4];
    }
    
  }
}

//envoyer CANBUS

if(millis()>=temps_can_send + refresh_can){
 unsigned char stmp[8] = {vitesse_avg,vitesse_avd,debat_avg/4,debat_avg%4,debat_avd/4,debat_avd%4,debat_cre/4,press_av/4};  
 CAN.sendMsgBuf(10, 0, 8, stmp);
 temps_can_send=millis();
}

temps = millis();
vitesse = (vitesse_avg+vitesse_avd)/2;

//afficher
u8g.firstPage();  
  do {
    if(temps<=5000){
    accueil();
    }
    else {
    affichage();
    }
  } while( u8g.nextPage() );
    delay(10);
    

    
}
